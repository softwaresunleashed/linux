## Linux/drivers/cust_driver/Kconfig
```kconfig
menu "Custom Drivers by Sudhanshu"

source "drivers/cust_driver/_utils/Kconfig"

source "drivers/cust_driver/webcam/Kconfig"

source "drivers/cust_driver/gpio_fun/Kconfig"

source "drivers/cust_driver/scull/Kconfig"

source "drivers/cust_driver/keypad/Kconfig"

source "drivers/cust_driver/rtc/Kconfig"

source "drivers/cust_driver/motor_control/Kconfig"

endmenu 
```

## Linux/drivers/cust_driver/_utils/Kconfig
```kconfig
menuconfig CUST_DRIVER_UTILS
	bool "Cust Driver Utilities"
	---help---
	  Say Y here to get to see options for Utilities for Cust Device Drivers
	  Utilities generally involve support for custom drivers
	  e.g. BCM_I2C , BCM_GPIO 

	  If you say N, all options in this submenu will be skipped and disabled.

if CUST_DRIVER_UTILS

config BCM_CUST_GPIO
	bool "Custom GPIO Drivers for Cust Drivers"
	---help---
	Say Y here if you wish to enable Library Support for Custom GPIO drivers

 
config BCM_CUST_I2C
	bool "Custom I2C Drivers for Cust Drivers"
	---help---
	Say Y here if you wish to enable Library Support for Custom I2C drivers


endif # CUST_DRIVER_UTILS
```

## Linux/drivers/cust_driver/gpio_fun/Kconfig
```kconfig
config GPIO_FUN_ENABLE
	tristate "Support for GPIO functionality"
	depends on BCM_CUST_GPIO
	default n
	---help---
	Enable this option if you wish to Play around with GPIO pins
```

## Linux/drivers/cust_driver/keypad/Kconfig
```kconfig
config KEYPAD_ENABLE
	tristate "Support for 4x3 External Keypad Interfacing"
	---help---
	Enable this option if you wish to interface 4x3 External Keypad to Raspberry Pi
```

## Linux/drivers/cust_driver/motor_control/Kconfig
```kconfig
config MOTORCONTROL_L298N_ENABLE
	tristate "Support for Motor Controller H-Bridge Driver IC - L298N Interfacing"
	---help---
	Enable this option if you wish to control motor via H-Bridge Driver IC - L298N to Raspberry Pi
```

## Linux/drivers/cust_driver/rtc/Kconfig
```kconfig
config RTC_DS1307_ENABLE
	tristate "Support for External RTC (DS1307) Sub-System Interfacing"
	depends on BCM_CUST_I2C
	---help---
	Enable this option if you wish to interface 4x3 External Keypad to Raspberry Pi
```

## Linux/drivers/cust_driver/scull/Kconfig
```kconfig
config SCULL_CHAR_DRIVER_ENABLE
	tristate "Support for SCULL CHAR device drives"
	---help---
	Enable this option if you wish to install SCULL CHAR device drivers
```

## Linux/drivers/cust_driver/webcam/Kconfig
```kconfig
config WEBCAM_SUPPORT_ENABLE
	tristate "Support for USB Webcams"
	---help---
	Enable this option if you wish to install drivers for USB Webcams
```
